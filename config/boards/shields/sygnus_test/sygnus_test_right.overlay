#include "sygnus_test.dtsi"

&default_transform {
    col-offset = <2>;
};

&kscan0 {
    // Mirror column order for right side
    col-gpios = <&xiao_d 5 (GPIO_ACTIVE_LOW | GPIO_PULL_UP)>,
                <&xiao_d 4 (GPIO_ACTIVE_LOW | GPIO_PULL_UP)>;
};
