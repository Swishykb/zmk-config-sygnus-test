## config/boards/shields/sygnus_test/Kconfig.shield
```kconfig
config SHIELD_SYGNUS_TEST_LEFT
    def_bool $(shields_list_contains,sygnus_test_left)

config SHIELD_SYGNUS_TEST_RIGHT
    def_bool $(shields_list_contains,sygnus_test_right)
```
